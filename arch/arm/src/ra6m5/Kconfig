## arch/risc-v/src/sty32c2/Kconfig
```kconfig
#
# For a description of the syntax of this configuration file,
# see the file kconfig-language.txt in the NuttX tools repository.
#

comment "STY32C2 Configuration Options"

menu "STY32C2 Peripheral Support"

# These are the peripheral selections proper

config STY32C2_UART
	bool
	default n

config STY32C2_UART0
	bool "UART0"
	default y
	select UART0_SERIALDRIVER
	select ARCH_HAVE_UART0
	select ARCH_HAVE_SERIAL_TERMIOS
	select STY32C2_UART

if ARCH_BOARD_ULX3S

config STY32C2_UART1
	bool "UART1"
	default n
	select UART1_SERIALDRIVER
	select ARCH_HAVE_UART1
	select ARCH_HAVE_SERIAL_TERMIOS
	select STY32C2_UART

config STY32C2_UART2
	bool "UART2"
	default n
	select UART2_SERIALDRIVER
	select ARCH_HAVE_UART2
	select ARCH_HAVE_SERIAL_TERMIOS
	select STY32C2_UART

config STY32C2_UART3
	bool "UART3"
	default n
	select UART3_SERIALDRIVER
	select ARCH_HAVE_UART3
	select ARCH_HAVE_SERIAL_TERMIOS
	select STY32C2_UART

config STY32C2_UART4
	bool "UART4"
	default n
	select UART4_SERIALDRIVER
	select ARCH_HAVE_UART4
	select ARCH_HAVE_SERIAL_TERMIOS
	select STY32C2_UART

config STY32C2_UART5
	bool "UART5"
	default n
	select UART5_SERIALDRIVER
	select ARCH_HAVE_UART5
	select ARCH_HAVE_SERIAL_TERMIOS
	select STY32C2_UART

config STY32C2_UART6
	bool "UART6"
	default n
	select UART6_SERIALDRIVER
	select ARCH_HAVE_UART6
	select ARCH_HAVE_SERIAL_TERMIOS
	select STY32C2_UART

config STY32C2_I2C
	bool
	default n

config STY32C2_I2C0
	bool "I2C0"
	default n
	select I2C
	select I2C_DRIVER
	select I2C_BITBANG
	select STY32C2_I2C

config STY32C2_I2C1
	bool "I2C1"
	default n
	select I2C
	select I2C_DRIVER
	select I2C_BITBANG
	select STY32C2_I2C

config STY32C2_SPI
	bool
	default n

config STY32C2_SPI0
	bool "SPI0"
	default n
	select SPI
	select SPI_DRIVER
	select STY32C2_SPI

config STY32C2_SPI1
	bool "SPI1"
	default n
	select SPI
	select SPI_DRIVER
	select STY32C2_SPI

config STY32C2_SPI2
	bool "SPI2"
	default n
	select SPI
	select SPI_DRIVER
	select STY32C2_SPI

config STY32C2_PWM
	bool "PWM"
	default n
	select PWM
	select PWM_MULTICHAN
	select ARCH_HAVE_PWM_MULTICHAN

config STY32C2_RTC
	bool "RTC"
	default n
	select RTC

endif

config STY32C2_SDIO
	bool "SDIO"
	default n
	select SCHED_HPWORK
	select MMCSD
	select MMCSD_SDIO
	select SDIO_BLOCKSETUP
	select ARCH_HAVE_SDIO
	select SDIO_DMA

config STY32C2_SDIO1
	bool "Enable SDIO1"
	default y if STY32C2_SDIO
	select STY32C2_SDIO_DMA
	depends on STY32C2_SDIO

if STY32C2_SDIO1

config STY32C2_IDMODE_FREQ
	int "ID mode frequency"
	default 400000
	---help---
		Initial, ID mode SD frequency

config STY32C2_MMCXFR_FREQ
	int "MMC transfer frequency"
	default 25000000
	---help---
		Frequency to use for transferring data to/from an MMC card

config STY32C2_SD4BIT_FREQ
	int "SD 4-bit transfer frequency"
	default 50000000
	---help---
		Frequency to use for transferring data to/from an SD card using all four data lines.

endif

config STY32C2_ETHMAC
	bool "ETHMAC"
	default n
	select ARCH_HAVE_PHY
	select ARCH_HAVE_NETDEV_STATISTICS
	select NET
	select NETDEVICES

endmenu

menu "STY32C2 EMAC device driver options"
	depends on STY32C2_ETHMAC

config STY32C2_EMAC_PHYADDR
	int "PHY address"
	default 1
	---help---
		The 5-bit address of the PHY on the board.  Default: 1

endmenu # PHY interface
```

## boards/arm/stm32/glcx96/Kconfig
```kconfig
#
# For a description of the syntax of this configuration file,
# see the file kconfig-language.txt in the NuttX tools repository.
#

if ARCH_BOARD_GLCX96

menu "PLC Features"
config GLCX96_HSO
	bool "Support GLCX96 High-speed outputs"
	default n
  
if GLCX96_HSO
config GLCX96_HSO_CH0
	bool "Enable GLCX96 HSO Ch0"
	default n

config GLCX96_HSO_CH1
  bool "Enable GLCX96 HSO Ch1"
  default n
  
config GLCX96_HSO_CH2
  bool "Enable GLCX96 HSO Ch2"
  default n
endif # GLCX96_HSO

config GLCX96_HSI
  bool "Support GLCX96 High-speed inputs"
  default n

if GLCX96_HSI
config GLCX96_HSI_CH0
	bool "Enable GLCX96 HSI Ch0"
	default n

config GLCX96_HSI_CH1
  bool "Enable GLCX96 HSI Ch1"
  default n
  
config GLCX96_HSI_CH2
  bool "Enable GLCX96 HSI Ch2"
  default n
endif # GLCX96_HSI

endmenu

if BOARD_LATE_INITIALIZE

config GLCX96_BOARDINIT_PRIO
	int "Board initialization thread priority"
	default 196
	---help---
		If BOARD_LATE_INITIALIZE initialize is defined, then the function
		board_late_initialize() will be called to perform board-specific
		initialization. board_late_initialize() runs on the IDLE thread.
		Depending on the features that are enabled, this  board
		initialization logic may need to start a kernel thread that has
		more capability than the IDLE thread.  This setting then provides
		the priority of the board initialization thread.

		NOTE:  GLCX96_BOARDINIT_PRIO should have a relatively high
		priority to assure that board level initialization completes
		before the application requires the initialized board services.
		Default: 196

config GLCX96_BOARDINIT_STACK
	int "Board initialization thread Size"
	default DEFAULT_TASK_STACKSIZE
	---help---
		If BOARD_LATE_INITIALIZE initialize is defined, then the function
		board_late_initialize() will be called to perform board-specific
		initialization. board_late_initialize() runs on the IDLE thread.
		Depending on the features that are enabled, this  board
		initialization logic may need to start a kernel thread that has
		more capability than the IDLE thread.  This setting then provides
		the size of the stack to use with the initialization kernel thread.

endif # BOARD_LATE_INITIALIZE
endif # ARCH_BOARD_GLCX96
```

## boards/risc-v/mpfs/icicle/Kconfig
```kconfig
#
# For a description of the syntax of this configuration file,
# see misc/tools/kconfig-language.txt.
#

if ARCH_BOARD_ICICLE_MPFS

config ICICLE_MPFS_EXEC_HART1
	bool "Enable code execution on HART1"
	default n

config ICICLE_MPFS_EXEC_HART2
  bool "Enable code execution on HART2"
  default n
  
config ICICLE_MPFS_EXEC_HART3
  bool "Enable code execution on HART3"
  default n
  
config ICICLE_MPFS_EXEC_HART4
  bool "Enable code execution on HART4"
  default n
  
endif
```

## boards/risc-v/sty32c2/ulx3s/Kconfig
```kconfig
#
# For a description of the syntax of this configuration file,
# see misc/tools/kconfig-language.txt.
#

if ARCH_BOARD_ULX3S


config STY32C2_SDIO
	bool "SDIO"
	default n
	select SCHED_HPWORK
	select MMCSD
	select MMCSD_SDIO
	select SDIO_BLOCKSETUP
	select ARCH_HAVE_SDIO
	select SDIO_DMA

config STY32C2_SDIO1
	bool "Enable SDIO1"
	default y if STY32C2_SDIO
	select STY32C2_SDIO_DMA
	depends on STY32C2_SDIO

config STY32C2_IDMODE_FREQ
	int "ID mode frequency"
	default 400000
	depends on STY32C2_SDIO
	---help---
		Initial, ID mode SD frequency

config STY32C2_MMCXFR_FREQ
	int "MMC transfer frequency"
	default 25000000
	depends on STY32C2_SDIO
	---help---
		Frequency to use for transferring data to/from an MMC card

config STY32C2_SD4BIT_FREQ
	int "SD 4-bit transfer frequency"
	default 50000000
	depends on STY32C2_SDIO
	---help---
		Frequency to use for transferring data to/from an SD card using all four data lines.

config STY32C2_SDIO_MOUNT
	bool "Mount SDIO at startup"
	default n
	depends on STY32C2_SDIO

config STY32C2_SDIO_MOUNT_BLKDEV
	string "SDIO block device name"
	default "/dev/mmcsd0"
	depends on STY32C2_SDIO

config STY32C2_SDIO_MOUNT_MOUNTPOINT
	string "SDIO mountpoint"
	default "/mnt"
	depends on STY32C2_SDIO

config STY32C2_SDIO_MOUNT_FSTYPE
	string "SDIO file system type"
	default "vfat"
	depends on STY32C2_SDIO

config STY32C2_APPLICATION_RAMDISK
	bool "Use application ramdisk"
	depends on BUILD_KERNEL
	---help---
		The application ramdisk is currently only intended only to hold 
		application elfs in the romfs format. These applications must loaded
		externally into ram through sty32c2_term, or similar method.

endif
```
